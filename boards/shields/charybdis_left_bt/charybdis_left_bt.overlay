#include "../charybdis_common/charybdis.dtsi"

&kscan0 {
	compatible = "zmk,kscan-gpio-matrix";
	
	col-gpios
		= <&pro_micro 19 (GPIO_ACTIVE_HIGH | GPIO_PULL_DOWN)> // 19
		, <&pro_micro 20 (GPIO_ACTIVE_HIGH | GPIO_PULL_DOWN)> // 20
		, <&pro_micro 10 (GPIO_ACTIVE_HIGH | GPIO_PULL_DOWN)> // 10
		, <&pro_micro 6 (GPIO_ACTIVE_HIGH | GPIO_PULL_DOWN)>  //  6
		, <&pro_micro 7 (GPIO_ACTIVE_HIGH | GPIO_PULL_DOWN)>  //  7
		, <&pro_micro 8 (GPIO_ACTIVE_HIGH | GPIO_PULL_DOWN)>  //  8
		;

	row-gpios
		= <&pro_micro 21 GPIO_ACTIVE_HIGH>  // 18
		, <&pro_micro 18 GPIO_ACTIVE_HIGH>  //  5
		, <&pro_micro 5 GPIO_ACTIVE_HIGH>   //  4
		, <&pro_micro 4 GPIO_ACTIVE_HIGH>   //  9
		;
};
