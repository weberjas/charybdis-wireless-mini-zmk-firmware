#include "../charybdis_common/charybdis.dtsi"
#include "../charybdis_trackball/charybdis_pmw3610.dtsi"
#include "../../config/trackball/charybdis_pointer.dtsi"

// The matrix transform is 6 columns over because the left half is 6 columns wide.
&default_transform {
	col-offset = <6>;
};

&five_column_transform {
	col-offset = <5>;
};

// KSCAN matrix
&kscan0 {
	compatible = "zmk,kscan-gpio-matrix";
	
	col-gpios
		= <&pro_micro 4 (GPIO_ACTIVE_HIGH | GPIO_PULL_DOWN)>   // 19
		, <&pro_micro 3 (GPIO_ACTIVE_HIGH | GPIO_PULL_DOWN)>   // 20
		, <&pro_micro 9 (GPIO_ACTIVE_HIGH | GPIO_PULL_DOWN)>   // 10
		, <&pro_micro 15 (GPIO_ACTIVE_HIGH | GPIO_PULL_DOWN)>  //  6
		, <&pro_micro 14 (GPIO_ACTIVE_HIGH | GPIO_PULL_DOWN)>  //  7
		, <&pro_micro 16 (GPIO_ACTIVE_HIGH | GPIO_PULL_DOWN)>  //  8
		;

	row-gpios
		= <&pro_micro 2 GPIO_ACTIVE_HIGH> // 18
		, <&pro_micro 5 GPIO_ACTIVE_HIGH>  //  5
		, <&pro_micro 18 GPIO_ACTIVE_HIGH>  //  4
		, <&pro_micro 19 GPIO_ACTIVE_HIGH>  //  9
		;
};

/* enable the listener on central */
&trackball_listener {
    status = "okay";
    device = <&trackball>;
};
